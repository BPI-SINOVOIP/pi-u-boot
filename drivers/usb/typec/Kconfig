## drivers/usb/typec/Kconfig
```kconfig
# SPDX-License-Identifier: GPL-2.0+
#

comment "USB TYPEC"

config TYPEC_HUSB239
	bool "HUSB239 typec controller"
```

## drivers/video/spacemit/Kconfig
```kconfig
# SPDX-License-Identifier: GPL-2.0

menuconfig VIDEO_SPACEMIT
	bool "Enable SPACEMIT Video Support"
	depends on DM_VIDEO
	help
	  SPACEMIT SoCs provide video output capabilities for High-Definition
	  Multimedia Interface (HDMI) and Display Serial Interface (DSI).

	  This driver supports the on-chip video output device.

config VIDEO_SPACEMIT_MAX_XRES
        int "Maximum horizontal resolution (for memory allocation purposes)"
	depends on VIDEO_SPACEMIT
	default 1920
	help
	  The maximum horizontal resolution to support for the framebuffer.
	  This configuration is used for reserving/allocating memory for the
	  framebuffer during device-model binding/probing.

config VIDEO_SPACEMIT_MAX_YRES
        int "Maximum vertical resolution (for memory allocation purposes)"
	depends on VIDEO_SPACEMIT
	default 1200
	help
	  The maximum vertical resolution to support for the framebuffer.
	  This configuration is used for reserving/allocating memory for the
	  framebuffer during device-model binding/probing.

if VIDEO_SPACEMIT

config DISPLAY_SPACEMIT_HDMI
	bool "HDMI port"
	select VIDEO_DW_HDMI
	depends on VIDEO_SPACEMIT
	help
	  This enables High-Definition Multimedia Interface display support.

config DISPLAY_SPACEMIT_MIPI
	bool "MIPI Port"
	depends on VIDEO_SPACEMIT
	help
	  This enables Mobile Industry Processor Interface(MIPI) display
	  support.

endif
```

## fs/jffs2/Kconfig
```kconfig
config FS_JFFS2
	bool "Enable JFFS2 filesystem support"
	help
	  This provides support for reading images from JFFS2 (Journalling
	  Flash File System version 2). JFFS2 is a log-structured file system
	  for use with flash memory devices. It supports raw NAND devices,
	  hard links and compression.

config JFFS2_LZO
	bool "Enable LZO compression in JFFS2"
	depends on FS_JFFS2
	help
	  Enable LZO compression in the JFFS2 filesystem

config JFFS2_NAND
	bool "Enable JFFS2 support for NAND flash"
	depends on FS_JFFS2
	help
	  Enable support for NAND flash as the backing store for JFFS2.

config JFFS2_NOR
	bool "Enable JFFS2 support for NOR flash"
	depends on FS_JFFS2
	help
	  Enable support for NOR flash as the backing store for JFFS2.

choice
	prompt "Method for reading from NOR flash"
	depends on JFFS2_NOR

config JFFS2_USE_MEMMAP_READ
	bool "Use memcopy for reading from NOR flash"
	help
	  Use the memcopy function to read data from NOR flash.

config JFFS2_USE_MTD_READ
	bool "Use mtd.read for reading from NOR flash"
	help
	  Use the mtd.read function to read data from NOR flash.

endchoice
```
