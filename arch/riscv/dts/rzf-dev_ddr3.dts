// SPDX-License-Identifier: GPL-2.0
/*
 * Device Tree Source for the GR-Peach board
 *
 * Copyright (C) 2017 Jacopo Mondi <jacopo+renesas@jmondi.org>
 * Copyright (C) 2021 Renesas Electronics
 */

/dts-v1/;
#include <dt-bindings/gpio/gpio.h>
#include "r9a07g043f.dtsi"
#include "rzf-dev-common.dtsi"
/ {
	model = "rzf-dev";
	compatible = "renesas,rzf";

	aliases {
		serial0 = &scif0;
	};

	chosen {
		stdout-path = "serial0:115200n8";
	};

	memory@48000000 {
		u-boot,dm-spl;
		device_type = "memory";
		/* first 128MB is reserved for secure area. */
		reg = <0 0x48000000 0 0x18000000>;
	};
};
