## arch/arm/mach-synaptics/Kconfig
```kconfig
if ARCH_SYNAPTICS

config SYS_SOC
	default "synaptics"

config SYS_VENDOR
	default "synaptics"

choice
	prompt "Synaptics board select"

config TARGET_AS370
	bool "Synaptics AS370 SoC"
	select ARM64
	help
	  The Synaptics AS370 is a ARM64-based SoC with a quad-core Cortex-A53.
	  including UART, SPI, USB2.0 and OTG, NAND, EMMC, USB Ethernet

config TARGET_VS680
	bool "Synaptics VS680 SoC"
	select ARM64
	help
	  The Synaptics VS680 is a ARM64-based SoC with a quad-core Cortex-A73.
	  including UART, SPI, USB2.0 and OTG, NAND, EMMC, USB Ethernet, etc.

config TARGET_VS680_A0
	bool "Synaptics VS680 SoC"
	select ARM64
	help
	  The Synaptics VS680 is a ARM64-based SoC with a quad-core Cortex-A73.
	  including UART, SPI, USB2.0 and OTG, NAND, EMMC, USB Ethernet, etc.

config TARGET_VS680_C05
	bool "Synaptics VS680 SoC"
	select ARM64
	help
	  The Synaptics VS680 is a ARM64-based SoC with a quad-core Cortex-A73.
	  including UART, SPI, USB2.0 and OTG, NAND, EMMC, USB Ethernet, etc.

config TARGET_VS640
	bool "Synaptics VS640 SoC"
	select ARM64
	help
	  The Synaptics AS640 is a ARM64-based SoC with a quad-core Cortex-A55.
	  including UART, SPI, USB2.0 and OTG, EMMC, etc.
endchoice

source "arch/arm/mach-synaptics/driver/Kconfig"

# source "board/synaptics/as370/Kconfig"
source "board/synaptics/vs680/Kconfig"
source "board/synaptics/vs680a0/Kconfig"
source "board/synaptics/vs680_c05/Kconfig"
# source "board/synaptics/vs640/Kconfig"


menu "Synaptics Specific Setup"

choice
	prompt "Select fastboot/spi-uboot/usb-uboot"
config USB_BOOT
	bool "BOOT from USB tool"
	help
	  Enable boot from USB tool including download, burn image through USB

config SYNA_FASTBOOT
	bool "synaptics FASTBOOT support"
	help
	  Support Synaptics fastboot

config SYNA_SPIBOOT
	bool "synaptics SPI uboot support"
	help
	  Support Synaptics fastboot

config SYNA_OEMBOOT
	bool "synaptics OEMBOOT support"
	help
		Support Synaptics OEMBOOT solution

endchoice

config SYNA_OEMBOOT_FLASH_MMC_DEV
	int "Define OEMBOOT MMC FLASH default device"
	depends on SYNA_OEMBOOT
	help
	  The oemboot "flash" command requires additional information
	  regarding the non-volatile storage device. Define this to
	  the eMMC device that oemboot should use to read the image.

config CMD_IRQ_SYNA
	bool "CMD to test irq function"

config USE_IRQ_SYNA
	bool "Support IRQ function of Synaptics' chip"

config SYNA_SM
	bool "Support System Manager in U-Boot"
	depends on SYNA_OEMBOOT

config SYNA_INCLUDE_SM_FW
	bool "Build System Manager firmware into U-Boot"
	depends on SYNA_SM
endmenu

endif
```

## arch/arm/mach-synaptics/driver/Kconfig
```kconfig
menu "Synaptics driver support"
source "arch/arm/mach-synaptics/driver/nand/Kconfig"
source "arch/arm/mach-synaptics/driver/fts/Kconfig"
source "arch/arm/mach-synaptics/driver/fastboot/Kconfig"

choice
	prompt "Synaptics GEN2/GENX flow select"

config SYNA_GEN2_FLOW
	bool "Synaptics GEN2 flow"
	select USB_BOOT

config SYNA_GENX_FLOW
	bool "Synaptics GENX flow"
	select USB_BOOT
endchoice
endmenu
```

## arch/arm/mach-synaptics/driver/fastboot/Kconfig
```kconfig
menu "Synaptics Fastboot Setup"

config SYNA_FASTBOOT_GUI_ENABLE
	bool "Fastboot gui enable"
	depends on CMD_SYNA_FASTBOOT_GUI
	default y
	help
		add switch to disable GUI if GUI components are not ready

config SYNA_DISPLAY_TA
	bool "Using TA to display GUI"
	depends on SYNA_FASTBOOT_GUI_ENABLE || SYNA_OEMBOOT
	default y
	select BOARD_LATE_INIT
	help
		for security reason, we need call display driver through fastlogo ta

config SYNA_FASTBOOT_GUI_BUTTON
	bool "Use button to change/select reboot option"
	depends on SYNA_FASTBOOT_GUI_ENABLE
	default y
	select DM_KEYBOARD
	select ADC_KEY

choice
	prompt "Select Place to Store Bootflag"

config SYNA_BOOTFLAG_IN_SM
	bool "Bootflag is in SM memory"
	depends on FASTBOOT
	select SYNA_SM
	help
	  select this indicate that the bootflag is stored in SM

config SYNA_BOOTFLAG_IN_FTS
	bool "Bootflag is in flash-ts"
	depends on FASTBOOT
	select FLASH_TS_MMC
	help
	  select this indicate that the bootflag is stored in flash ts

endchoice

config SYNA_BOOTFLAG_IN_DTCM
	bool "Bootflag is in SM DTCM as reboot msg"
	depends on FASTBOOT
	help
	  select this indicate that the bootflag is stored in SM reboot msg

config SYNA_FB_BOOT
	bool "Boot from download image through fastboot"
	depends on SYNA_BOOTFLAG_IN_SM

config SYNA_FASTBOOT_AB
	bool "Fastboot support AB bootflow"
	depends on FASTBOOT
	select SYNA_BOOTFLAG_IN_FTS
	help
	  select this indicate that AB flow boot_ctrl Hal is enabled

config SYNA_FASTBOOT_RPMB_LOCK
	bool "Fastboot store lock flag in rpmb"
	depends on FASTBOOT
	select SUPPORT_EMMC_RPMB
	help
	  select this indicate that AB flow boot_ctrl Hal is enabled
endmenu
```

## arch/arm/mach-synaptics/driver/fts/Kconfig
```kconfig
config FLASH_TS_MMC
	bool "Enable Flash-based transactional key-value based on MMC"
	depends on DM_MMC
	help
	  Enable Flash-based transactional key-value based on MMC.

config FLASH_MMC_DEV
	int "Define MMC FLASH default device"
	default 0
	help
	  Define this to the eMMC device that used to do fts.
```

## arch/arm/mach-synaptics/driver/nand/Kconfig
```kconfig
config NAND_CNDS
	bool "Support for NAND on Cadence HPNFC"
	depends on ARCH_SYNAPTICS
	default n
	---help---
	Enable support for NAND. Support for Cadence HPNFC.

config NAND_RANDOMIZER
	bool "Enable nand randomizer when do nand read/write"
	depends on NAND_CNDS
	default n
```

## arch/riscv/cpu/rzfive/rzmpu/Kconfig
```kconfig
if TARGET_RZF_DEV || TARGET_SMARC_RZF

config ARCH_RZMPU
	bool "RZFMPU architecture"
	default y

choice
	prompt "SoC type select"
	default RZF_DEV

config RZF_DEV
	bool "RZ/Five type"
endchoice

choice
	prompt "DDR type select"
	default RZF_DDR_C_011_D4_01_1

config RZF_DDR_C_010_D3_02_2
	bool "param_mc_C-010_D3-02-2"

config RZF_DDR_C_010_D4_01_1
	bool "param_mc_C-010_D4-01-1"

config RZF_DDR_C_010_D4_01_2
	bool "param_mc_C-010_D4-01-2"

config RZF_DDR_C_011_D4_01_1
	bool "param_mc_C-011_D4-01-1"

config RZF_DDR_C_011_D4_01_2
	bool "param_mc_C-011_D4-01-2"
endchoice

endif
```

## board/renesas/rzv2h-dev/Kconfig
```kconfig
if TARGET_RZV2H_DEV

config SYS_SOC
	default "rmobile"

config SYS_BOARD
	default "rzv2h-dev"

config SYS_VENDOR
	default "renesas"

config SYS_CONFIG_NAME
	default "rzv2h-dev"

endif

if TARGET_RZV2H_EVK_ALPHA

config SYS_SOC
	default "rmobile"

config SYS_BOARD
	default "rzv2h-dev"

config SYS_VENDOR
	default "renesas"

config SYS_CONFIG_NAME
	default "rzv2h-dev"

endif

if TARGET_SMARC_RZV2H

config SYS_SOC
	default "rmobile"

config SYS_BOARD
	default "rzv2h-dev"

config SYS_VENDOR
	default "renesas"

config SYS_CONFIG_NAME
	default "smarc-rzv2h"

endif
```

## board/spacemit/k1-x/Kconfig
```kconfig
if TARGET_SPACEMIT_K1X

config SYS_BOARD
	default "k1-x"

config SYS_VENDOR
	default "spacemit"

config SYS_CPU
	default "x60"

config SYS_CONFIG_NAME
	default "k1-x"

config SYS_TEXT_BASE
	default 0x81200000 if SPL
	default 0x80000000 if !RISCV_SMODE
	default 0x80200000 if RISCV_SMODE && ARCH_RV64I
	default 0x80400000 if RISCV_SMODE && ARCH_RV32I

config SPL_TEXT_BASE
	default 0x20100000

config SPL_OPENSBI_LOAD_ADDR
	hex
	default 0x21000000

config FDT_ADD_MEMORY_NODE
	bool "enable to add memory node to fdt before boot kernel"
	default n

config SPACEMIT_BUILD_BIN
	bool "build fsbl.bin for spacemit image"
	default n

config BOARD_SPECIFIC_OPTIONS # dummy
	def_bool y
	select SPACEMIT_X60
	select FDT_ADD_MEMORY_NODE
	imply AHCI
	imply SMP
	imply BOARD_LATE_INIT
	imply PCI_INIT_R
	imply SPL_RAM_SUPPORT
	imply SPL_RAM_DEVICE
	imply CMD_PCI
	imply CMD_POWEROFF
	imply CMD_SBI
	imply CMD_SCSI
	imply CMD_PING
	imply CMD_EXT2
	imply CMD_EXT4
	imply CMD_FAT
	imply CMD_FS_GENERIC
	imply DOS_PARTITION
	imply ISO_PARTITION
	imply EFI_PARTITION
	imply SCSI_AHCI
	imply AHCI_PCI
	imply E1000
	imply NVME
	imply PCI
	imply PCIE_ECAM_GENERIC
	imply SCSI
	imply DM_SCSI
	imply SYS_NS16550
	imply SIFIVE_SERIAL
	imply HTIF_CONSOLE if 64BIT
	imply SYSRESET
	imply SYSRESET_CMD_POWEROFF
	imply SYSRESET_SYSCON
	imply VIRTIO_MMIO
	imply VIRTIO_PCI
	imply VIRTIO_NET
	imply VIRTIO_BLK
	imply MTD_NOR_FLASH
	imply CFI_FLASH
	imply OF_HAS_PRIOR_STAGE

choice
	prompt "product board"
	default K1_X_BOARD_FPGA

config K1_X_BOARD_FPGA
	bool "k1-x board fpga"
	help
	  k1-x board is fpga.

config K1_X_BOARD_ASIC
	bool "k1-x board asic"
	help
	  k1-x board is asic.

config K1_X_BOARD_SIMULATION
	bool "k1-x board simulation"
	help
	  k1-x board is simulation.
endchoice

endif
```

## board/spacemit/k1-x/configs/uboot_fdt.its
```
/dts-v1/;

/ {
	description = "U-boot FIT image for k1x";
	#address-cells = <2>;
	fit,fdt-list = "of-list";

	images {
		uboot {
			description = "U-Boot";
			type = "standalone";
			os = "U-Boot";
			arch = "riscv";
			compression = "none";
			load = <0x0 0x00200000>;
			data = /incbin/("../u-boot-nodtb.bin");
			hash-1 {
				algo = "crc32";
			};
		};

		fdt_1 {
			description = "k1-x_evb";
			type = "flat_dt";
			compression = "none";
			data = /incbin/("../dtb/k1-x_evb.dtb");
			hash-1 {
				algo = "crc32";
			};
		};
		fdt_2 {
			description = "k1-x_deb1";
			type = "flat_dt";
			compression = "none";
			data = /incbin/("../dtb/k1-x_deb1.dtb");
			hash-1 {
				algo = "crc32";
			};
		};
		fdt_3 {
			description = "k1-x_deb2";
			type = "flat_dt";
			compression = "none";
			data = /incbin/("../dtb/k1-x_deb2.dtb");
			hash-1 {
				algo = "crc32";
			};
		};
		fdt_4 {
			description = "k1-x_hs450";
			type = "flat_dt";
			compression = "none";
			data = /incbin/("../dtb/k1-x_hs450.dtb");
			hash-1 {
				algo = "crc32";
			};
		};
		fdt_5 {
			description = "k1-x_kx312";
			type = "flat_dt";
			compression = "none";
			data = /incbin/("../dtb/k1-x_kx312.dtb");
			hash-1 {
				algo = "crc32";
			};
		};
		fdt_6 {
			description = "k1-x_MINI-PC";
			type = "flat_dt";
			compression = "none";
			data = /incbin/("../dtb/k1-x_MINI-PC.dtb");
			hash-1 {
				algo = "crc32";
			};
		};
		fdt_7 {
			description = "k1-x_mingo";
			type = "flat_dt";
			compression = "none";
			data = /incbin/("../dtb/k1-x_mingo.dtb");
			hash-1 {
				algo = "crc32";
			};
		};
		fdt_8 {
			description = "k1-x_MUSE-N1";
			type = "flat_dt";
			compression = "none";
			data = /incbin/("../dtb/k1-x_MUSE-N1.dtb");
			hash-1 {
				algo = "crc32";
			};
		};
		fdt_9 {
			description = "k1-x_MUSE-Pi";
			type = "flat_dt";
			compression = "none";
			data = /incbin/("../dtb/k1-x_MUSE-Pi.dtb");
			hash-1 {
				algo = "crc32";
			};
		};
	};

	configurations {
		default = "conf_1";
		conf_1 {
			description = "k1-x_evb";
			loadables = "uboot";
			fdt = "fdt_1";
		};
		conf_2 {
			description = "k1-x_deb1";
			loadables = "uboot";
			fdt = "fdt_2";
		};
		conf_3 {
			description = "k1-x_deb2";
			loadables = "uboot";
			fdt = "fdt_3";
		};
		conf_4 {
			description = "k1-x_hs450";
			loadables = "uboot";
			fdt = "fdt_4";
		};
		conf_5 {
			description = "k1-x_kx312";
			loadables = "uboot";
			fdt = "fdt_5";
		};
		conf_6 {
			description = "k1-x_MINI-PC";
			loadables = "uboot";
			fdt = "fdt_6";
		};
		conf_7 {
			description = "k1-x_mingo";
			loadables = "uboot";
			fdt = "fdt_7";
		};
		conf_8 {
			description = "k1-x_MUSE-N1";
			loadables = "uboot";
			fdt = "fdt_8";
		};
		conf_9 {
			description = "k1-x_MUSE-Pi";
			loadables = "uboot";
			fdt = "fdt_9";
		};
	};
};
```

## board/synaptics/as370/Kconfig
```kconfig
if TARGET_AS370

config SYS_BOARD
	default "as370"

config SYS_CONFIG_NAME
	default "as370"

endif
```

## board/synaptics/vs640/Kconfig
```kconfig
if TARGET_VS640

config SYS_BOARD
	default "vs640"

config SYS_CONFIG_NAME
	default "vs640"

endif
```

## board/synaptics/vs680/Kconfig
```kconfig
if TARGET_VS680

config SYS_BOARD
	default "vs680"

config SYS_CONFIG_NAME
	default "vs680"

endif
```

## board/synaptics/vs680_c05/Kconfig
```kconfig
if TARGET_VS680_C05

config SYS_BOARD
	default "vs680_c05"

config SYS_CONFIG_NAME
	default "vs680"

endif
```

## board/synaptics/vs680a0/Kconfig
```kconfig
if TARGET_VS680_A0

config SYS_BOARD
	default "vs680a0"

config SYS_CONFIG_NAME
	default "vs680a0"

endif
```

## cmd/syna/Kconfig
```kconfig
menu "Synaptics specific command line interface"

config CMD_USBLOAD
	bool "usb load"
	depends on USB_BOOT
	default y
	help
	  use the command to download images through usb cable

config CMD_SYNA_FASTBOOT_GUI
	bool "Enable GUI for Fastboot"
	depends on USB_FUNCTION_FASTBOOT || UDP_FUNCTION_FASTBOOT

config CMD_SYNA_FTS
	bool "Enable Android Flash-based transactional key-value store command"
	depends on MISC
	help
	  Enable Flash-based transactional key-value based on MMC.

config CMD_SYNA_PRELOAD_TA
	bool "Enable register ta command"
	depends on SYNA_OEMBOOT

config CMD_SYNA_FDT_UPDATE
	bool "Enable FDT update before booting Kernel"
	depends on SYNA_OEMBOOT
endmenu
```
