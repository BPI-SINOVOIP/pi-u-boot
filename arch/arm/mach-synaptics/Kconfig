## configs/k1-x_fpga_2x2_defconfig
```kconfig
CONFIG_RISCV=y
CONFIG_SYS_TEXT_BASE=0x00200000
CONFIG_SYS_MALLOC_LEN=0x800000
CONFIG_NR_DRAM_BANKS=1
CONFIG_ENV_SIZE=0x4000
CONFIG_ENV_OFFSET=0x80000
CONFIG_DEFAULT_DEVICE_TREE="k1-x_fpga_2x2"
CONFIG_SPL_TEXT_BASE=0xC0801000
CONFIG_SPL_MMC=y
CONFIG_SPL_SIZE_LIMIT=0x30000
CONFIG_SPL=y
CONFIG_SYS_LOAD_ADDR=0x200000
# CONFIG_AHCI is not set
CONFIG_TARGET_SPACEMIT_K1X=y
CONFIG_SPL_OPENSBI_LOAD_ADDR=0x0
CONFIG_ARCH_RV64I=y
CONFIG_RISCV_SMODE=y
CONFIG_LOCALVERSION="spacemit"
CONFIG_ENV_VARS_UBOOT_CONFIG=y
CONFIG_HAS_CUSTOM_SYS_INIT_SP_ADDR=y
CONFIG_CUSTOM_SYS_INIT_SP_ADDR=0x1000000
CONFIG_STACK_SIZE=0x100000
CONFIG_FIT=y
# CONFIG_FIT_FULL_CHECK is not set
CONFIG_SPL_LOAD_FIT_ADDRESS=0x40000000
# CONFIG_BOOTSTD is not set
# CONFIG_LEGACY_IMAGE_FORMAT is not set
CONFIG_SUPPORT_RAW_INITRD=y
CONFIG_BOOTDELAY=0
CONFIG_AUTOBOOT_KEYED=y
CONFIG_AUTOBOOT_STOP_STR="s"
CONFIG_USE_BOOTCOMMAND=y
CONFIG_BOOTCOMMAND="bootm 0x50000000"
CONFIG_DISPLAY_CPUINFO=y
CONFIG_DISPLAY_BOARDINFO=y
CONFIG_SPL_MAX_SIZE=0x30000
CONFIG_SPL_PAD_TO=0x0
CONFIG_SPL_BSS_START_ADDR=0xC0830000
CONFIG_SPL_BSS_MAX_SIZE=0x8000
CONFIG_SPL_BOARD_INIT=y
# CONFIG_SPL_RAW_IMAGE_SUPPORT is not set
# CONFIG_SPL_SHARES_INIT_SP_ADDR is not set
CONFIG_SPL_STACK=0xc0840000
CONFIG_SYS_SPL_MALLOC=y
CONFIG_HAS_CUSTOM_SPL_MALLOC_START=y
CONFIG_CUSTOM_SYS_SPL_MALLOC_ADDR=0x4000000
CONFIG_SYS_SPL_MALLOC_SIZE=0x2000000
CONFIG_SYS_MMCSD_RAW_MODE_U_BOOT_USE_PARTITION=y
CONFIG_SYS_MMCSD_RAW_MODE_U_BOOT_PARTITION_NAME="opensbi"
CONFIG_SYS_MMCSD_RAW_MODE_U_BOOT_SEC_PARTITION=y
CONFIG_SYS_MMCSD_RAW_MODE_U_BOOT_SEC_PARTITION_INDEX=0x2
CONFIG_SYS_MMCSD_RAW_MODE_U_BOOT_SEC_PARTITION_NAME="uboot"
CONFIG_SPL_ENV_SUPPORT=y
CONFIG_SPL_DM_RESET=y
CONFIG_SPL_USB_GADGET=y
CONFIG_SPL_FASTBOOT_LOAD=y
CONFIG_SPL_USB_SDP_SUPPORT=y
CONFIG_SPL_OPENSBI_SCRATCH_OPTIONS=0x0
CONFIG_HUSH_PARSER=y
CONFIG_SYS_CBSIZE=256
CONFIG_SYS_PBSIZE=276
# CONFIG_CMD_CPU is not set
CONFIG_SYS_BOOTM_LEN=0xa000000
CONFIG_CMD_GPT=y
CONFIG_CMD_GPT_RENAME=y
CONFIG_CMD_MMC=y
CONFIG_CMD_BKOPS_ENABLE=y
CONFIG_CMD_MTD=y
CONFIG_CMD_PART=y
# CONFIG_CMD_SCSI is not set
CONFIG_CMD_DHCP=y
CONFIG_SYS_DISABLE_AUTOLOAD=y
CONFIG_CMD_PXE=y
CONFIG_CMD_SYSBOOT=y
CONFIG_CMD_MTDPARTS=y
CONFIG_CMD_MTDPARTS_SPREAD=y
CONFIG_CMD_MTDPARTS_SHOW_NET_SIZES=y
CONFIG_MTDIDS_DEFAULT="nor0=spi-nor"
CONFIG_MTDPARTS_DEFAULT="spi-nor:448K(reserve),2M(uboot)"
CONFIG_SPACEMIT_FLASH=y
CONFIG_SPL_FASTBOOT=y
CONFIG_PARTITION_TYPE_GUID=y
CONFIG_ENV_IS_NOWHERE=y
CONFIG_ENV_IS_IN_MMC=y
CONFIG_SYS_MMC_ENV_DEV=1
# CONFIG_SPL_ENV_IS_NOWHERE is not set
CONFIG_PROT_UDP=y
CONFIG_NET_RANDOM_ETHADDR=y
CONFIG_IP_DEFRAG=y
CONFIG_KEEP_SERVERADDR=y
CONFIG_BOOTP_SERVERIP=y
CONFIG_DEVRES=y
# CONFIG_SCSI_AHCI is not set
# CONFIG_CLK is not set
CONFIG_DMA=y
CONFIG_DMA_CHANNELS=y
CONFIG_USB_FUNCTION_FASTBOOT=y
CONFIG_FASTBOOT_BUF_ADDR=0x40000000
CONFIG_FASTBOOT_BUF_SIZE=0x10000000
CONFIG_FASTBOOT_FLASH=y
CONFIG_FASTBOOT_FLASH_MMC_DEV=1
CONFIG_FASTBOOT_MMC_BOOT_SUPPORT=y
CONFIG_FASTBOOT_MMC_BOOT1_NAME="fsbl"
CONFIG_FASTBOOT_MMC_BOOT2_NAME="fsbl_1"
# CONFIG_GPIO is not set
# CONFIG_I2C is not set
# CONFIG_INPUT is not set
CONFIG_MISC=y
CONFIG_MMC=y
CONFIG_SUPPORT_EMMC_BOOT=y
CONFIG_MMC_SDHCI=y
CONFIG_MMC_SDHCI_ADMA=y
CONFIG_MMC_SDHCI_K1X=y
CONFIG_DM_MTD=y
# CONFIG_MTD_NOR_FLASH is not set
CONFIG_SPACEMIT_K1X_EMAC=y
CONFIG_NVME_PCI=y
CONFIG_PCIE_DW_K1X=y
CONFIG_PINCTRL=y
CONFIG_PINCTRL_SINGLE=y
CONFIG_RESET_SPACEMIT_K1X=y
# CONFIG_SCSI is not set
# CONFIG_DM_SCSI is not set
CONFIG_SYS_NS16550_IER=0x40
# CONFIG_HTIF_CONSOLE is not set
# CONFIG_SIFIVE_SERIAL is not set
CONFIG_TIMER_EARLY=y
CONFIG_USB=y
CONFIG_USB_GADGET=y
CONFIG_USB_GADGET_VENDOR_NUM=0x361C
CONFIG_USB_GADGET_PRODUCT_NUM=0x1001
CONFIG_USB2_K1X_CI=y
# CONFIG_BINMAN_FDT is not set
# CONFIG_SPL_USE_TINY_PRINTF is not set
```

## configs/rzf-fpga_defconfig
```kconfig
# configuration of RISC-V
CONFIG_RISCV=y
CONFIG_ARCH_RV64I=y
CONFIG_RISCV_SMODE=y
CONFIG_CACHE=y
CONFIG_RISCV_NDS_CACHE=y
CONFIG_V5L2_CACHE=y
CONFIG_TARGET_RZF_DEV=y
CONFIG_RZF_DEV=y
CONFIG_DEFAULT_DEVICE_TREE="rzf-dev"
CONFIG_DEFAULT_FDT_FILE="rzf-dev.dtb"
CONFIG_RISCV_RDTIME=y
# configuration of U-BOOT
#CONFIG_SYS_TEXT_BASE=0x50000000
CONFIG_BOARD_EARLY_INIT_F=y
CONFIG_SPL_FRAMEWORK_BOARD_INIT_F=n
CONFIG_FIT=y
CONFIG_HAVE_BLOCK_DEVICE=y
CONFIG_REGMAP=y
CONFIG_SYSCON=y
CONFIG_HUSH_PARSER=y
CONFIG_VERSION_VARIABLE=y
CONFIG_DISPLAY_BOARDINFO=y
CONFIG_DISPLAY_CPUINFO=y
CONFIG_ENV_SIZE=0x20000
CONFIG_ENV_OFFSET=0xFFFE0000
CONFIG_ENV_IS_IN_MMC=y
CONFIG_ENV_OVERWRITE=y
CONFIG_SYS_RELOC_GD_ENV_ADDR=y
CONFIG_DISTRO_DEFAULTS=y
CONFIG_SUPPORT_RAW_INITRD=y
CONFIG_USE_BOOTARGS=y
CONFIG_BOOTARGS="root=/dev/nfs rw nfsroot=192.168.0.1:/export/rfs ip=192.168.0.20"
CONFIG_BOOTCOMMAND="ext4load mmc 0:1 0x48080000 Image;ext4load mmc 0:1 0x48000000 "CONFIG_DEFAULT_FDT_FILE";booti 0x48080000 - 0x48000000"
CONFIG_SMBIOS_MANUFACTURER=""
CONFIG_SMBIOS_PRODUCT_NAME=""
# configuration of OF
CONFIG_OF_CONTROL=y
CONFIG_OF_SEPARATE=y
CONFIG_OF_LIST="rzf-dev"
CONFIG_OF_LIBFDT_OVERLAY=y
# configuration of driver
CONFIG_CLK=y
CONFIG_CLK_RENESAS=y
CONFIG_CLK_RCAR_GEN3=y
CONFIG_CLK_R9A07G044L=y
CONFIG_DM_GPIO=y
CONFIG_RCAR_GPIO=y
CONFIG_RZG2L_GPIO=y
CONFIG_PINCTRL=y
CONFIG_PINCTRL_PFC=y
CONFIG_PINCTRL_PFC_RZG2L=y
CONFIG_DM_I2C=y
CONFIG_SYS_I2C_RCAR_IIC=y
CONFIG_SH_SDHI=y
CONFIG_BITBANGMII=y
CONFIG_PHY_MICREL=y
CONFIG_PHY_MICREL_KSZ90X1=y
CONFIG_DM_ETH=y
CONFIG_RENESAS_RAVB=y
CONFIG_PCI=y
CONFIG_DM_PCI=y
CONFIG_PCI_RCAR_GEN3=y
CONFIG_DM_REGULATOR=y
CONFIG_DM_REGULATOR_FIXED=y
CONFIG_DM_REGULATOR_GPIO=y
CONFIG_SCIF_CONSOLE=y
CONFIG_USB=y
CONFIG_DM_USB=y
CONFIG_USB_XHCI_HCD=y
CONFIG_USB_EHCI_HCD=y
CONFIG_USB_EHCI_GENERIC=y
CONFIG_USB_STORAGE=y
CONFIG_MMC=y
CONFIG_SUPPORT_EMMC_RPMB=y
CONFIG_PHY=y
# configuration of SPL
CONFIG_SPL=y
CONFIG_SPL_CACHE=y
CONFIG_SPL_CACHE_SUPPORT=y
CONFIG_SPL_CPU_SUPPORT=y
CONFIG_SPL_SMP=n
CONFIG_SPL_SEPARATE_BSS=y
CONFIG_SPL_FIT=y
CONFIG_SPL_LOAD_FIT=y
CONFIG_USE_SPL_FIT_GENERATOR=y
CONFIG_SPL_FIT_GENERATOR="arch/riscv/lib/mkimage_fit_opensbi.sh"
CONFIG_SPL_OF_CONTROL=y
CONFIG_SPL_OF_LIST="rzv-dev"
CONFIG_SPL_DM=y
CONFIG_SPL_DM_SERIAL=y
CONFIG_SPL_SERIAL_PRESENT=y
CONFIG_SPL_NOR_SUPPORT=y
CONFIG_SPL_BLK=n
# configuration of CMD
CONFIG_CMD_BOOTZ=y
CONFIG_CMD_GPIO=y
CONFIG_CMD_I2C=y
CONFIG_CMD_MMC=y
CONFIG_CMD_PCI=y
CONFIG_CMD_USB=y
CONFIG_CMD_DHCP=y
CONFIG_CMD_MII=y
CONFIG_CMD_PING=y
CONFIG_CMD_EXT2=y
CONFIG_CMD_EXT4=y
CONFIG_CMD_EXT4_WRITE=y
CONFIG_CMD_FAT=y
CONFIG_CMD_FS_GENERIC=y
CONFIG_CMD_SBI=y
# configuration of DDR settings
#CONFIG_RZF_DDR_C_010_D3_02_2=y
#CONFIG_RZF_DDR_C_010_D4_01_1=y
#CONFIG_RZF_DDR_C_010_D4_01_2=y
#CONFIG_RZF_DDR_C_011_D4_01_1=y
CONFIG_RZF_DDR_C_011_D4_01_2=y
#CONFIG_RZF_DDR_SWIZZLE_T1BC=y
#CONFIG_RZF_DDR_SWIZZLE_T1C=y
#CONFIG_RZF_DDR_SWIZZLE_T2C=y
#CONFIG_RZF_DDR_SWIZZLE_T3BC=y
#CONFIG_RZF_DDR_SWIZZLE_T3BCUD=y
#CONFIG_RZF_DDR_SWIZZLE_T3BCUD2=y
#CONFIG_RZF_DDR_SWIZZLE_T3BCUL=y
CONFIG_RZF_DDR_SWIZZLE_T3CL=y
# configuration for DEBUG
CONFIG_DEBUG_RZF_FPGA=y
CONFIG_SYS_TEXT_BASE=0x20160000
CONFIG_SPL_OPENSBI_LOAD_ADDR=0x20100000
CONFIG_XIP=y
# configuration for OpenSBI debug
CONFIG_DEBUG_OPENSBI=y
CONFIG_SBI_V02=y
CONFIG_CMD_EXCEPTION=y
```

## drivers/clk/spacemit/Kconfig
```kconfig
# SPDX-License-Identifier: GPL-2.0
# common clock support for SPACEMIT SoC family.

config SPACEMIT_K1PRO_CCU
	tristate "Clock support for Spacemit k1pro SoCs"
	depends on CLK
        depends on CLK_CCF
	help
	  Build the driver for Spacemit K1pro Clock Driver.

config SPACEMIT_K1X_CCU
        tristate "Clock support for Spacemit k1x SoCs"
        select CLK
        select CLK_CCF
        help
          Build the driver for Spacemit K1x Clock Driver.
```

## drivers/ddr/Kconfig
```kconfig
source "drivers/ddr/altera/Kconfig"
source "drivers/ddr/imx/Kconfig"
source "drivers/ddr/renesas/Kconfig"
```

## drivers/ddr/renesas/Kconfig
```kconfig
if TARGET_RZF_DEV || TARGET_SMARC_RZF

choice
	prompt "DDR type select"
	default RZF_DDR_SWIZZLE_T3CL

config RZF_DDR_SWIZZLE_T1BC
	bool "param_swizzle_T1bc"

config RZF_DDR_SWIZZLE_T1C
	bool "param_swizzle_T1c"

config RZF_DDR_SWIZZLE_T2C
	bool "param_swizzle_T2c"

config RZF_DDR_SWIZZLE_T3BC
	bool "param_swizzle_T3bc"

config RZF_DDR_SWIZZLE_T3BCUD
	bool "param_swizzle_T3bcud"

config RZF_DDR_SWIZZLE_T3BCUD2
	bool "param_swizzle_T3bcud2"

config RZF_DDR_SWIZZLE_T3BCUL
	bool "param_swizzle_T3bcul"

config RZF_DDR_SWIZZLE_T3CL
	bool "param_swizzle_T3cl"
endchoice

config RZF_DDR_PLL4
	int "DDR clock"
	default 1600

config RZF_DDR_SIZE
	hex "DDR RAM size"
	default 0x40000000

endif
```

## drivers/net/spacemit/Kconfig
```kconfig
config SPACEMIT_K1X_EMAC
	bool "Sapcemit k1-x Emac Driver"
	depends on DM_ETH
	select PHYLIB
	select DM_RESET
	help
	  This Driver support Spacemit k1-x Ethernet MAC
	  Say Y to enable support for the Spacemit Ethernet.
```

## drivers/phy/spacemit/Kconfig
```kconfig
config PHY_SPACEMIT_K1X_USB2
	bool "Spacemit k1-x USB2 PHY Driver"
	depends on PHY
	help
	  Support for Spacemit k1-x USB 2 PHY

config SPL_PHY_SPACEMIT_K1X_USB2
	bool "Spacemit k1-x USB2 PHY Driver in SPL"
	depends on PHY
	help
	  Support for Spacemit k1-x USB 2 PHY

config PHY_SPACEMIT_K1X_COMBPHY
	tristate "Spacemit K1-x USB3&PCIE combo PHY driver"
	depends on PHY
	help
	  USB3 and PCIE Combo PHY Support for Spacemit k1-x Soc

config SPL_PHY_SPACEMIT_K1X_COMBPHY
	tristate "Spacemit K1-x USB3&PCIE combo PHY driver in SPL"
	depends on PHY
	help
	  USB3 and PCIE Combo PHY Support for Spacemit k1-x Soc
```

## drivers/phy/synaptics/Kconfig
```kconfig
config SYNA_USB_PHY
	bool "Synaptics usb PHY driver"
	depends on ARCH_SYNAPTICS
	default n
	help
	  Support usb3.0 PHY driver for Syanaptics
```

## drivers/pinctrl/spacemit/Kconfig
```kconfig
config PINCTRL_SPACEMIT
	bool

config PINCTRL_K1PRO
	bool "Spacemit K1PRO pinctrl driver"
	depends on TARGET_SPACEMIT_K1PRO && PINCTRL_FULL
	select DEVRES
	select PINCTRL_SPACEMIT
	help
	  Say Y here to enable the k1-pro pinctrl driver
```

## drivers/pinctrl/synaptics/Kconfig
```kconfig
if ARCH_SYNAPTICS

config PINCTRL_SYNAPTICS
	bool "Synaptics SoC pinctrl core driver"
	default y

config PINCTRL_SYNAPTICS_AS370
	bool "Synaptics AS370 SoC pinctrl driver"
	depends on TARGET_AS370
	default y
	select PINCTRL_SYNAPTICS

config PINCTRL_SYNAPTICS_VS680
	bool "Synaptics VS680 SoC pinctrl driver"
	depends on TARGET_VS680 || TARGET_VS680_A0
	default y
	select PINCTRL_SYNAPTICS

config PINCTRL_SYNAPTICS_VS640
	bool "Synaptics VS640 SoC pinctrl driver"
	depends on TARGET_VS640
	default y
	select PINCTRL_SYNAPTICS
endif
```
